#include "remove.dtsi"

#include "pinctrl.dtsi"
#include "msm8953-oxygen-pinctrl.dtsi"

#include "soc.dtsi"

#include "android.dtsi"
#include "audio.dtsi"
#include "battery.dtsi"
#include "display.dtsi"
#include "fingerprint.dtsi"
#include "misc.dtsi"
#include "ramoops.dtsi"
#include "power.dtsi"
#include "touchscreen.dtsi"

#include "msm8953-oxygen-camera-sensor-mtp.dtsi"
