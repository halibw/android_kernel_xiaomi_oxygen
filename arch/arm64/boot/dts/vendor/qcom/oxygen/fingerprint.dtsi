&soc {
	fp_vdd_vreg: fp_vdd_vreg {
		compatible = "regulator-fixed";
		regulator-name = "fp_vdd_vreg";
		startup-delay-us = <4000>;
		enable-active-high;
		gpio = <&tlmm 139 0>;
		regulator-always-on;
	};
	fingerprint_goodix {
		compatible = "goodix,fingerprint";
		interrupt-parent = <&tlmm>;
		interrupts = <48 0x0>;
		fp-gpio-irq = <&tlmm 48 0x1>;
		fp-gpio-reset = <&tlmm 50 0x0>;
		status = "okay";
	};
	fingerprint_fpc {
		status = "okay";
		compatible = "fpc,fpc1020";
		interrupt-parent = <&tlmm>;
		interrupts = <48 0x0>;
		fpc,gpio_rst = <&tlmm 50 0x0>;
		fpc,gpio_irq = <&tlmm 48 0x0>;
		vdd_ana-supply  = <&fp_vdd_vreg>;
		/* fpc,enable-on-boot; */
		/* fpc,enable-wakeup; */

		pinctrl-names = "fpc1020_reset_reset",
				"fpc1020_reset_active",
				"fpc1020_irq_active";

		pinctrl-0 = <&msm_gpio_50>;
		pinctrl-1 = <&msm_gpio_50_output_high>;
		pinctrl-2 = <&msm_gpio_48>;
	};
};
