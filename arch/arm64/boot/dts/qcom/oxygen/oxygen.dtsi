#include "remove.dtsi"

#include "pinctrl.dtsi"
#include "msm8953-oxygen-pinctrl.dtsi"

#include "android.dtsi"
#include "battery.dtsi"
#include "display.dtsi"
#include "misc.dtsi"
#include "ramoops.dtsi"
#include "power.dtsi"
#include "soc.dtsi"
#include "touchscreen.dtsi"
