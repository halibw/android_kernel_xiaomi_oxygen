/* msm8953-mdss-panels.dtsi */
#include "panel/dsi-panel-tianma-r63350-1080p-video.dtsi"
#include "panel/dsi-panel-auo-r61322-1080p-video.dtsi"

&dsi_tianma_r63350_1080p_vid {
	qcom,mdss-dsi-panel-timings-phy-v2 = [24 1f 08 09 05 03 04 a0
		24 1f 08 09 05 03 04 a0
		24 1f 08 09 05 03 04 a0
		24 1f 08 09 05 03 04 a0
		24 1b 08 09 05 03 04 a0];
};

&dsi_auo_r61322_1080p_vid {
	qcom,mdss-dsi-panel-timings-phy-v2 = [24 1f 08 09 05 03 04 a0
		24 1f 08 09 05 03 04 a0
		24 1f 08 09 05 03 04 a0
		24 1f 08 09 05 03 04 a0
		24 1b 08 09 05 03 04 a0];
};

/* msm8953-mdss.dtsi */
&mdss_dsi0 {
	/delete-property/ vdd-supply;
};

/* msm8953-mtp.dtsi */
&mdss_dsi0 {
	qcom,dsi-pref-prim-pan = <&dsi_tianma_r63350_1080p_vid>;
	qcom,platform-reset-gpio = <&tlmm 35 0>;
};

/* msm8953-oxygen.dtsi */
&mdss_dsi0 {
	/delete-property/ qcom,platform-bklight-en-gpio;
};
