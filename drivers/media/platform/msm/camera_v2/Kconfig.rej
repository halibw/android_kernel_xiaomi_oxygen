## drivers/media/platform/msm/camera_v2/Kconfig.rej
```kconfig
--- drivers/media/platform/msm/camera_v2/Kconfig
+++ drivers/media/platform/msm/camera_v2/Kconfig
@@ -1,5 +1,5 @@
 config MSM_CAMERA_SENSOR
-	    bool "QTI MSM camera sensor support"
+	    bool "Qualcomm MSM camera sensor support"
 	    depends on MSMB_CAMERA
 	    select NEW_LEDS
 	    select LEDS_CLASS
@@ -10,7 +10,7 @@ config MSM_CAMERA_SENSOR
           subdev APIs.
 
 config MSM_CPP
-        bool "QTI MSM Camera Post Processing Engine support"
+        bool "Qualcomm MSM Camera Post Processing Engine support"
         depends on MSMB_CAMERA
         ---help---
           Enable support for Camera Post-processing Engine
@@ -19,7 +19,7 @@ config MSM_CPP
           APIs.
 
 config MSM_CCI
-        bool "QTI MSM Camera Control Interface support"
+        bool "Qualcomm MSM Camera Control Interface support"
         depends on MSMB_CAMERA
         ---help---
           Enable support for Camera Control Interface driver only
@@ -29,7 +29,7 @@ config MSM_CCI
           GPIO and data frames.
 
 config MSM_CSI20_HEADER
-        bool "QTI MSM CSI 2.0 Header"
+        bool "Qualcomm MSM CSI 2.0 Header"
         depends on MSMB_CAMERA
         ---help---
           Enable support for CSI drivers to include 2.0
@@ -39,7 +39,7 @@ config MSM_CSI20_HEADER
           8930 and 8064 platforms.
 
 config MSM_CSI22_HEADER
-        bool "QTI MSM CSI 2.2 Header"
+        bool "Qualcomm MSM CSI 2.2 Header"
         depends on MSMB_CAMERA
         ---help---
           Enable support for CSI drivers to include 2.2
@@ -49,7 +49,7 @@ config MSM_CSI22_HEADER
           platform.
 
 config MSM_CSI30_HEADER
-        bool "QTI MSM CSI 3.0 Header"
+        bool "Qualcomm MSM CSI 3.0 Header"
         depends on MSMB_CAMERA
         ---help---
           Enable support for CSI drivers to include 3.0
@@ -59,7 +59,7 @@ config MSM_CSI30_HEADER
           8064 platforms.
 
 config MSM_CSI31_HEADER
-        bool "QTI MSM CSI 3.1 Header"
+        bool "Qualcomm MSM CSI 3.1 Header"
         depends on MSMB_CAMERA
         ---help---
           Enable support for CSI drivers to include 3.0
@@ -69,7 +69,7 @@ config MSM_CSI31_HEADER
           APQ8084 platform.
 
 config MSM_CSIPHY
-        bool "QTI MSM Camera Serial Interface Physical receiver support"
+        bool "Qualcomm MSM Camera Serial Interface Physical receiver support"
         depends on MSMB_CAMERA
         ---help---
           Enable support for Camera Serial Interface
@@ -78,7 +78,7 @@ config MSM_CSIPHY
           signalling.
 
 config MSM_CSID
-        bool "QTI MSM Camera Serial Interface decoder support"
+        bool "Qualcomm MSM Camera Serial Interface decoder support"
         depends on MSMB_CAMERA
         ---help---
           Enable support for Camera Serial Interface decoder.
@@ -87,7 +87,7 @@ config MSM_CSID
           and datatype.
 
 config MSM_EEPROM
-        bool "QTI MSM Camera ROM Interface for Calibration support"
+        bool "Qualcomm MSM Camera ROM Interface for Calibration support"
         depends on MSMB_CAMERA
         ---help---
           Enable support for ROM Interface for Calibration
@@ -95,17 +95,8 @@ config MSM_EEPROM
           and also provides support for writing data in case of FLASH ROM.
 	  Currently supports I2C, CCI and SPI protocol
 
-config MSM_ISP_V1
-        bool "QTI MSM Image Signal Processing interface support"
-        depends on MSMB_CAMERA
-        ---help---
-          Enable support for Image Signal Processing interface module.
-          This module acts as a crossbar between CSID and VFE. Output
-          of any CID of CSID can be routed to of of pixel or raw
-          data interface in VFE.
-
 config MSM_ISPIF
-        bool "QTI MSM Image Signal Processing interface support"
+        bool "Qualcomm MSM Image Signal Processing interface support"
         depends on MSMB_CAMERA
         ---help---
           Enable support for Image Signal Processing interface module.
@@ -114,7 +105,7 @@ config MSM_ISPIF
           data interface in VFE.
 
 config MSM_ISPIF_V1
-        bool "QTI MSM Image Signal Processing interface support"
+        bool "Qualcomm MSM Image Signal Processing interface support"
         depends on MSMB_CAMERA
         ---help---
           Enable support for Image Signal Processing interface module.
@@ -123,7 +114,7 @@ config MSM_ISPIF_V1
           or raw data interface in VFE.
 
 config MSM_ISPIF_V2
-        bool "QTI MSM Image Signal Processing interface support"
+        bool "Qualcomm MSM Image Signal Processing interface support"
         depends on MSMB_CAMERA
         ---help---
           Enable support for Image Signal Processing interface module.
@@ -213,7 +204,7 @@ config OV12830
 		2 lanes max fps is 18, 4 lanes max fps is 24.
 
 config MSM_V4L2_VIDEO_OVERLAY_DEVICE
-	tristate "QTI MSM V4l2 video overlay device"
+	tristate "Qualcomm MSM V4l2 video overlay device"
 	---help---
 	  Enables support for the MSM V4L2 video
 	  overlay driver. This allows video rendering
@@ -221,8 +212,8 @@ config MSM_V4L2_VIDEO_OVERLAY_DEVICE
 	  APIs, by using /dev/videoX device
 
 config MSMB_JPEG
-	tristate "QTI MSM Jpeg Encoder Engine support"
-        depends on MSMB_CAMERA && (ARCH_MSM8974 || ARCH_MSM8226 || ARCH_APQ8084 || ARCH_MSM8916 || ARCH_MSM8953 || ARCH_MSM)
+	tristate "Qualcomm MSM Jpeg Encoder Engine support"
+        depends on MSMB_CAMERA && (ARCH_MSM8974 || ARCH_MSM8226 || ARCH_APQ8084 || ARCH_MSM8916 || ARCH_MSM)
 	---help---
 	  Enable support for Jpeg Encoder/Decoder
 	  Engine for 8974.
@@ -230,7 +221,7 @@ config MSMB_JPEG
 	  for the JPEG 1.0 encoder and decoder.
 
 config MSM_GEMINI
-	tristate "QTI MSM Gemini JPEG engine support"
+	tristate "Qualcomm MSM Gemini JPEG engine support"
 	depends on MSMB_CAMERA && (ARCH_MSM7X30 || ARCH_MSM8X60 || ARCH_MSM8960)
 	---help---
 	  Enables support for the Gemini JPEG encoder
@@ -239,26 +230,14 @@ config MSM_GEMINI
 	  for JPEG encoding functionality.
 
 config MSM_FD
-	 tristate "QTI MSM FD face detection engine support"
+	 tristate "Qualcomm MSM FD face detection engine support"
 	 depends on MSMB_CAMERA
 	 ---help---
 	    Enables support for the MSM FD face detection engine.
 
 config MSM_JPEGDMA
-	tristate "QTI MSM Jpeg dma"
+	tristate "Qualcomm Technologies Inc. MSM Jpeg dma"
         depends on MSMB_CAMERA
         select V4L2_MEM2MEM_DEV
 	---help---
 	  Enable support for Jpeg dma engine.
-
-config MSM_SEC_CCI_TA_NAME
-	string "Name of TA to handle Secure CCI transactions"
-	depends on MSM_CCI
-	default "seccamdemo64"
-
-config MSM_SEC_CCI_DEBUG
-	bool "QTI MSM Secure CCI Relay Debug"
-	depends on MSM_CCI
-	---help---
-	  Enables simulation of secure camera for Secure CCI Realy
-	  debugging.
```
